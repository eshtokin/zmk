## boards/shields/toki_split1/Kconfig.defconfig
```kconfig
if SHIELD_TOKI_SPLIT1_LEFT

config ZMK_KEYBOARD_NAME
    default "toki_split1"

config ZMK_SPLIT_ROLE_CENTRAL
    default y

endif # SHIELD_TOKI_SPLIT1_LEFT

if SHIELD_TOKI_SPLIT1_LEFT || SHIELD_TOKI_SPLIT1_RIGHT

config ZMK_SPLIT
    default y

endif # SHIELD_TOKI_SPLIT1_LEFT || SHIELD_TOKI_SPLIT1_RIGHT
```

## boards/shields/toki_split1/Kconfig.shield
```kconfig
config SHIELD_TOKI_SPLIT1_LEFT
    def_bool $(shields_list_contains,toki_split1_left)

config SHIELD_TOKI_SPLIT1_RIGHT
    def_bool $(shields_list_contains,toki_split1_right)
```
